## firmware/sdkconfig.defaults
```kconfig
# Shared sdkconfig defaults for the Heartwood ESP32 firmware.
#
# This file is the common base applied to every build. Board-specific
# settings (console routing, flash size) live in the per-board fragments:
#
#   sdkconfig.defaults.heltec-v3  -- CP2102 UART bridge on UART0
#   sdkconfig.defaults.heltec-v4  -- native USB-Serial-JTAG on GPIO19/20
#
# The active fragment is selected via the ESP_IDF_SDKCONFIG_DEFAULTS env
# var, which is set either by .cargo/config.toml (default = heltec-v4) or
# by the scripts/build-firmware.sh wrapper for a V3 build. Later files in
# the semicolon-separated list override earlier ones -- see esp-idf-sys
# BUILD-OPTIONS.md.

# Chip target -- both Heltec V3 and V4 use the ESP32-S3.
CONFIG_IDF_TARGET="esp32s3"

# PSRAM disabled -- not needed for signing, avoids mode mismatch.
# The V4 has 2MB quad-SPI PSRAM, the V3 has none. We never allocate into
# PSRAM so leaving it off keeps one build profile valid for both boards.

# Large stack for elliptic curve operations on Xtensa.
CONFIG_ESP_MAIN_TASK_STACK_SIZE=32768

# --- TLS memory: dynamic buffers (fragmentation fix) ---
# By default mbedTLS pins a 16 KB RX + 4 KB TX content buffer for the whole
# life of each TLS session. On a no-PSRAM board that permanent block sits in
# the middle of the ~180 KB heap and, under the churn of a client bulk-
# decrypting a whole message history (nostr.com fires dozens of nip44_decrypt
# in a burst), fragments the heap until an allocation cannot be placed and the
# allocator aborts -- observed in the field as the signer "restarting itself"
# while decrypting. Dynamic buffers allocate the RX/TX buffer only while a
# record is in flight and free it afterwards, so the big block is not pinned
# and each transfer is right-sized. Compatible here: TLS 1.3 is off (relays use
# 1.2), and it selects the already-enabled asymmetric content length. An
# allocation failure now degrades to a TLS error -> clean reconnect, not a crash.
CONFIG_MBEDTLS_DYNAMIC_BUFFER=y

# Disable task watchdog -- provisioning blocks on stdin indefinitely.
# SECURITY NOTE: In production (post-provisioning), watchdog should be enabled
# to recover from hung signing operations. Tracked as a known hardening item.
CONFIG_ESP_TASK_WDT_INIT=n

# Keep the version embedded in the ESP-IDF application descriptor aligned with
# the Rust package/API version. scripts/build-firmware.sh rejects a drift before
# compiling, so release images never fall back to a stale `git describe` tag.
CONFIG_APP_PROJECT_VER_FROM_CONFIG=y
CONFIG_APP_PROJECT_VER="0.13.4"

# OTA support.
CONFIG_BOOTLOADER_APP_ROLLBACK_ENABLE=y
CONFIG_PARTITION_TABLE_CUSTOM=y
# esp-idf-sys generates its CMake project at target/<triple>/<profile>/build/
# esp-idf-sys-<hash>/out/. ESP-IDF resolves custom partition filenames
# relative to that directory (not the firmware root). The relative path below
# walks back up 6 levels from out/ to firmware/ where partitions.csv lives.
# This avoids the build-order race where build.rs can't copy the file before
# esp-idf-sys needs it.
CONFIG_PARTITION_TABLE_CUSTOM_FILENAME="../../../../../../partitions.csv"

# SECURITY NOTE: NVS flash encryption is NOT enabled in this configuration.
# Master private keys are stored in plaintext NVS -- a physical flash dump
# (JTAG in pre-fuse state or USB ROM mode) will expose key material.
#
# Production hardening (TODO):
#   - Enable flash encryption: CONFIG_FLASH_ENCRYPTION_ENABLED=y
#   - Enable NVS encryption: CONFIG_NVS_ENCRYPTION=y
#   - Disable JTAG after provisioning (via eFuse or CONFIG_ESP_SYSTEM_JTAG_DISABLE)
#   - Enable secure boot v2: CONFIG_SECURE_BOOT=y
#
# These are deferred because they require one-time eFuse burning that bricks
# the device if done incorrectly. They must be done in a controlled production
# flash step, not during development iteration.
```

## firmware/sdkconfig.defaults.c6
```kconfig
# Waveshare ESP32-C6-LCD-1.47 board-specific sdkconfig overrides.
#
# ESP32-C6 (RISC-V rv32imac), ST7789 172x320 portrait colour TFT over SPI, and
# the chip's native USB-Serial-JTAG (GPIO12 D- / GPIO13 D+) carrying the binary
# frame protocol.
#
# Layered AFTER the shared sdkconfig.defaults, so it overrides the chip target,
# console routing and partition table the Heltec (ESP32-S3) builds use.

# Chip target -- ESP32-C6 (overrides the shared "esp32s3").
CONFIG_IDF_TARGET="esp32c6"

# Flash -- the Waveshare C6-LCD-1.47 ships with 4MB.
CONFIG_ESPTOOLPY_FLASHSIZE_4MB=y

# Console routing: UNLIKE the ESP32-S3 (whose default console is UART0, harmless
# because it is not wired to USB-C), the C6's default *secondary* console is the
# USB-Serial-JTAG peripheral -- the very channel we use for the frame protocol.
# Left enabled, ESP-IDF log lines would interleave with and corrupt frame data,
# so the console is silenced entirely (as on the UART0-sharing T-Display). For
# bench debugging, route logs to UART0 instead of disabling them here.
CONFIG_ESP_CONSOLE_NONE=y

# 4MB single-OTA partition layout (see partitions-4mb.csv). Overrides the shared
# 8MB dual-OTA table.
CONFIG_PARTITION_TABLE_CUSTOM_FILENAME="../../../../../../partitions-4mb.csv"

# No second OTA slot in the 4MB single-app layout, so the bootloader rollback
# feature (which needs otadata + ota_0/ota_1) is not applicable here.
CONFIG_BOOTLOADER_APP_ROLLBACK_ENABLE=n
```

## firmware/sdkconfig.defaults.tdisplay
```kconfig
# LilyGO / TENSTAR T-Display board-specific sdkconfig overrides.
#
# Classic ESP32-D0WD (Xtensa LX6, not the S3), ST7789 240x135 colour TFT over
# SPI, and a CH9102 USB-to-UART bridge wired to UART0 (TX0 GPIO1 / RX0 GPIO3).
#
# This fragment is layered AFTER the shared sdkconfig.defaults, so it overrides
# the chip target and partition table the Heltec (ESP32-S3) builds use.

# Chip target -- classic ESP32 (overrides the shared "esp32s3").
CONFIG_IDF_TARGET="esp32"

# Flash -- the T-Display ships with 4MB.
CONFIG_ESPTOOLPY_FLASHSIZE_4MB=y

# Console routing: like the Heltec V3, the USB bridge shares UART0 with the
# binary frame protocol, so the ESP-IDF console must be silenced or its log
# lines would interleave with (and corrupt) frame data.
CONFIG_ESP_CONSOLE_NONE=y

# 4MB single-OTA partition layout (see partitions-4mb.csv). Overrides the
# shared 8MB dual-OTA table.
CONFIG_PARTITION_TABLE_CUSTOM_FILENAME="../../../../../../partitions-4mb.csv"

# No second OTA slot in the 4MB single-app layout, so the bootloader rollback
# feature (which needs otadata + ota_0/ota_1) is not applicable here.
CONFIG_BOOTLOADER_APP_ROLLBACK_ENABLE=n
```

## sdkconfig.defaults
```kconfig
# Heltec WiFi LoRa 32 V4 — ESP32-S3
CONFIG_IDF_TARGET="esp32s3"

# 2MB PSRAM (octal)
CONFIG_SPIRAM=y
CONFIG_SPIRAM_MODE_OCT=y

# Enough stack for crypto operations
CONFIG_ESP_MAIN_TASK_STACK_SIZE=16384
```
